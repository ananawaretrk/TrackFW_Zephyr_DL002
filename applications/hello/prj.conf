## CMakeLists.txt
```
# SPDX-License-Identifier: Apache-2.0

cmake_minimum_required(VERSION 3.20.0)

find_package(Zephyr REQUIRED HINTS $ENV{ZEPHYR_BASE})
project(hello_world)

target_sources(app PRIVATE src/main.c src/hct6911.c src/pt100.c)
```

## prj.conf
```kconfig
CONFIG_CONSOLE=y
CONFIG_USE_SEGGER_RTT=y
CONFIG_RTT_CONSOLE=y
CONFIG_UART_CONSOLE=n
CONFIG_SEGGER_RTT_BUFFER_SIZE_UP=2048
CONFIG_SEGGER_RTT_MAX_NUM_UP_BUFFERS=1

# SPI to the HCT6911 temperature ADC
CONFIG_SPI=y

# Bluetooth: advertise only (no connections yet)
CONFIG_BT=y
CONFIG_BT_BROADCASTER=y
CONFIG_BT_DEVICE_NAME="DL002"
```

## src/main.c
```c
/*
 * Copyright (c) 2012-2014 Wind River Systems, Inc.
 *
 * SPDX-License-Identifier: Apache-2.0
 */

#include <stdio.h>
#include <stdbool.h>
#include <stdint.h>                 /* INT16_MIN */
#include <math.h>                   /* lroundf() */
#include <zephyr/kernel.h>          /* k_msleep() */
#include <zephyr/drivers/gpio.h>    /* GPIO / LED functions */
#include <zephyr/sys/byteorder.h>   /* sys_put_be16() */
#include <zephyr/bluetooth/bluetooth.h>
#include "hct6911.h"                /* temperature ADC (PT100 front end) */
#include "pt100.h"                  /* code -> ohm -> °C */

/* LED pin info from the devicetree (dl002.dts) */
static const struct gpio_dt_spec led_green = GPIO_DT_SPEC_GET(DT_ALIAS(led0), gpios);
static const struct gpio_dt_spec led_red   = GPIO_DT_SPEC_GET(DT_ALIAS(led1), gpios);

/* Button pin info from the devicetree (alias "sw0" -> PB01, active low, pull-up) */
static const struct gpio_dt_spec button = GPIO_DT_SPEC_GET(DT_ALIAS(sw0), gpios);

/* Holds our callback registration (Zephyr needs this to remember who to call) */
static struct gpio_callback button_cb;

static volatile int press_count;

/* Manufacturer data, 10 bytes, as seen in nRF Connect:
 * FF FF             company 0xFFFF (test only, not shippable)
 * D4 4A 85 BF 3E 17 MAC, same order as the boot log
 * 09 24             temperature, int16 big-endian, 0.01 °C (0x0924 = 2340 = 23.40 °C)
 */
#define MFG_MAC_OFFSET   2
#define MFG_TEMP_OFFSET  8
#define TEMP_NO_READING  INT16_MIN   /* 0x8000: no valid reading */

/* Each cycle: read the temperature, start advertising (an alarm stops it after
 * ADV_DURATION_MS), sleep ADV_CYCLE_MS
 */
#define ADV_INTERVAL_MS  20     /* time between packets while advertising (BLE min 20 ms) */
#define ADV_DURATION_MS  100    /* how long we advertise each cycle */
#define ADV_CYCLE_MS     5000   /* start of one cycle to the start of the next (+ reading time) */

BUILD_ASSERT(ADV_DURATION_MS < ADV_CYCLE_MS, "advertising must be shorter than the cycle");

static uint8_t mfg_data[10] = { 0xFF, 0xFF, [MFG_TEMP_OFFSET] = 0x80 };   /* temp starts as 0x8000 */

static const struct bt_data ad[] = {
	BT_DATA_BYTES(BT_DATA_FLAGS, BT_LE_AD_NO_BREDR),
	BT_DATA(BT_DATA_NAME_COMPLETE, CONFIG_BT_DEVICE_NAME, sizeof(CONFIG_BT_DEVICE_NAME) - 1),
	BT_DATA(BT_DATA_MANUFACTURER_DATA, mfg_data, sizeof(mfg_data)),
};

/* Called by Zephyr the instant the button is pressed (runs in interrupt context) */
static void button_pressed(const struct device *dev, struct gpio_callback *cb, uint32_t pins)
{
	press_count++;
	printk("BUTTON pressed! (%d)\n", press_count);
}

/* Runs ADV_DURATION_MS after advertising starts (same idea as AL300's stop_adv_wk): radio off */
static void stop_adv_handler(struct k_work *work)
{
	ARG_UNUSED(work);
	bt_le_adv_stop();
}

static K_WORK_DELAYABLE_DEFINE(stop_adv_work, stop_adv_handler);

/* Wake the HCT6911, turn the excitation current back on (setup_pt100), take one reading and put
 * it back to sleep. Returns the temperature in 0.01 °C, or TEMP_NO_READING on any failure
 * (the function that failed has already printed why).
 */
static int16_t read_temperature(void)
{
	int32_t pt100_code;
	bool reading_ok = (hct6911_wake() == 0) &&
			  (hct6911_setup_pt100() == 0) &&
			  (hct6911_read_raw(&pt100_code) == 0);

	/* Back to sleep (< 1 uA) even if the reading failed */
	hct6911_sleep();

	if (!reading_ok) {
		return TEMP_NO_READING;
	}

	float r_ohm = pt100_code_to_ohm(pt100_code);
	float temp_c = pt100_ohm_to_celsius(r_ohm);

	if (temp_c < PT100_MIN_CELSIUS || temp_c > PT100_MAX_CELSIUS) {
		printf("PT100 out of range: R = %.3f ohm (probe unplugged or shorted?)\n", (double)r_ohm);
		return TEMP_NO_READING;
	}

	/* printf takes doubles: (double) makes the float -> double step explicit */
	printf("PT100 R = %.3f ohm, T = %.2f C\n", (double)r_ohm, (double)temp_c);

	/* 23.40 °C -> 2340 (rounded, so 23.3999 doesn't become 2339) */
	return (int16_t)lroundf(temp_c * 100.0f);
}

int main(void)
{
	if (!gpio_is_ready_dt(&led_green) || !gpio_is_ready_dt(&led_red)) {
		printf("LED GPIO not ready\n");
		return 0;
	}

	/* Both pins are outputs, both LEDs off (each one lit costs mA) */
	gpio_pin_configure_dt(&led_green, GPIO_OUTPUT_INACTIVE);
	gpio_pin_configure_dt(&led_red, GPIO_OUTPUT_INACTIVE);

	if (!gpio_is_ready_dt(&button)) {
		printf("Button GPIO not ready\n");
		return 0;
	}

	/* Make the pin an input (pull-up comes from the DTS flags) */
	gpio_pin_configure_dt(&button, GPIO_INPUT);

	/* Interrupt when the button becomes "active" = pressed */
	gpio_pin_interrupt_configure_dt(&button, GPIO_INT_EDGE_TO_ACTIVE);

	/* Tell Zephyr: on an interrupt for this pin, call button_pressed() */
	gpio_init_callback(&button_cb, button_pressed, BIT(button.pin));
	gpio_add_callback(button.port, &button_cb);

	printf("Hello World! %s\n", CONFIG_BOARD_TARGET);

	/* Temperature ADC (powered from boot, see adc_3v3 in dl002.dts): init, reset, configure
	 * for the PT100, then sleep until the first reading.
	 * Stops at the first failing step; that function prints why.
	 */
	bool adc_ready = (hct6911_init() == 0) &&
			 (hct6911_reset() == 0) &&
			 (hct6911_setup_pt100() == 0) &&
			 (hct6911_sleep() == 0);

	if (!adc_ready) {
		printf("HCT6911 not ready: no temperature readings\n");
	}

	/* Start the Bluetooth stack (radio library, controller) */
	int err = bt_enable(NULL);
	if (err) {
		printf("Bluetooth init failed (err %d)\n", err);
		return 0;
	}
	printf("Bluetooth initialized\n");

	/* Our own (identity) address, e.g. D4:4A:85:BF:3E:17 (public) */
	bt_addr_le_t identity_address;
	size_t identity_count = 1;
	char address_text[BT_ADDR_LE_STR_LEN];

	bt_id_get(&identity_address, &identity_count);
	bt_addr_le_to_str(&identity_address, address_text, sizeof(address_text));
	printf("Bluetooth address %s\n", address_text);

	/* Copy the MAC into the advertisement. Zephyr stores it reversed, so val[5] goes first
	 * to make it read the same as the boot log.
	 */
	for (int byte_index = 0; byte_index < 6; byte_index++) {
		mfg_data[MFG_MAC_OFFSET + byte_index] = identity_address.a.val[5 - byte_index];
	}

	printf("Advertising as %s: %d ms (packet every %d ms) every %d ms\n", CONFIG_BT_DEVICE_NAME,
	       ADV_DURATION_MS, ADV_INTERVAL_MS, ADV_CYCLE_MS);

	while (1) {
		/* Stays 0x8000 unless we get a valid reading below */
		int16_t temp_centi_celsius = TEMP_NO_READING;

		if (adc_ready) {
			temp_centi_celsius = read_temperature();
		}

		/* Put the temperature into the advertisement (big-endian: 2340 -> 09 24) */
		sys_put_be16((uint16_t)temp_centi_celsius, &mfg_data[MFG_TEMP_OFFSET]);

		/* Start advertising: non-connectable, fixed identity address, one packet every ADV_INTERVAL_MS */
		err = bt_le_adv_start(BT_LE_ADV_PARAM(BT_LE_ADV_OPT_USE_IDENTITY,
						      BT_GAP_MS_TO_ADV_INTERVAL(ADV_INTERVAL_MS),
						      BT_GAP_MS_TO_ADV_INTERVAL(ADV_INTERVAL_MS), NULL),
				      ad, ARRAY_SIZE(ad), NULL, 0);
		if (err) {
			printf("Advertising failed to start (err %d)\n", err);
		} else {
			/* Alarm: stop advertising after ADV_DURATION_MS */
			k_work_schedule(&stop_adv_work, K_MSEC(ADV_DURATION_MS));
		}

		/* The alarm stops advertising during this sleep; CONFIG_PM puts the chip in EM2 */
		k_msleep(ADV_CYCLE_MS);
	}

	return 0;
}
```

## src/hct6911.c
```c
/*
 * HCT6911 24-bit ADC: SPI register access + PT100 measurement (bring-up steps 3 and 4).
 * [HCT] = HCT6911 datasheet, printed page numbers
 *         (English pages: HCT6911_datasheet_EN_selected_pages.pdf).
 */

#include <stdio.h>
#include <zephyr/kernel.h>
#include <zephyr/drivers/spi.h>
#include <zephyr/drivers/gpio.h>
#include <zephyr/sys/byteorder.h>	/* sys_get_be24/32, sys_put_be24/32 */
#include "hct6911.h"

/* SPI mode 0 (no CPOL/CPHA flags): SCLK idles low, sampled on rising edge ([HCT] p.31-32) */
static const struct spi_dt_spec hct = SPI_DT_SPEC_GET(DT_NODELABEL(hct6911),
						      SPI_WORD_SET(8) | SPI_TRANSFER_MSB);

/* Same device, but CS stays LOW between calls until spi_release_dt().
 * A conversion frame needs CS low from the command until the data is read ([HCT] p.26, Fig 4-7).
 */
static const struct spi_dt_spec hct_conv = SPI_DT_SPEC_GET(DT_NODELABEL(hct6911),
							   SPI_WORD_SET(8) | SPI_TRANSFER_MSB |
							   SPI_HOLD_ON_CS | SPI_LOCK_ON);

/* DOUT/DRDY# shares the MISO pin: it goes LOW when a conversion result is ready */
static const struct gpio_dt_spec drdy = GPIO_DT_SPEC_GET(DT_NODELABEL(hct6911), drdy_gpios);

/*
 * Command byte ([HCT] p.21, Table 4-1/4-2):
 *   bit 7    = 0 (read/write frame)
 *   bits 6:2 = register address
 *   bit 1    = 1 read, 0 write
 *   bit 0    = odd parity: makes the total number of 1s in the byte odd
 */
static uint8_t hct6911_cmd(uint8_t addr, bool read)
{
	uint8_t cmd = (addr << 2) | (read ? BIT(1) : 0);

	if (__builtin_popcount(cmd) % 2 == 0) {
		cmd |= BIT(0);
	}
	return cmd;
}

/*
 * Read one HCT6911 register.
 *   addr:   register address, e.g. HCT6911_SYS_CONF0
 *   nbytes: register size, HCT6911_REG_24BIT or HCT6911_REG_32BIT
 *   value:  where to store the result (pass &my_variable)
 * Returns 0 on success, or a negative SPI error code.
 *
 * On the wire ([HCT] p.24, Fig 4-3/4-4), CS low for the whole frame:
 *   MOSI: [read command] [00] [00] [00] ([00])
 *   MISO: [junk        ] [data, biggest byte first]
 */
int hct6911_read_reg(uint8_t addr, int nbytes, uint32_t *value)
{
	uint8_t tx[1 + HCT6911_REG_32BIT] = { hct6911_cmd(addr, true) };	/* rest is 0x00 while we listen */
	uint8_t rx[1 + HCT6911_REG_32BIT];
	const struct spi_buf tx_buf = { .buf = tx, .len = 1 + nbytes };
	const struct spi_buf rx_buf = { .buf = rx, .len = 1 + nbytes };
	const struct spi_buf_set tx_set = { .buffers = &tx_buf, .count = 1 };
	const struct spi_buf_set rx_set = { .buffers = &rx_buf, .count = 1 };

	int err = spi_transceive_dt(&hct, &tx_set, &rx_set);

	/* rx[0] arrived while the chip was still receiving the command: skip it */
	if (nbytes == HCT6911_REG_32BIT) {
		*value = sys_get_be32(&rx[1]);
	} else {
		*value = sys_get_be24(&rx[1]);
	}
	return err;
}

/*
 * Write one HCT6911 register.
 *   addr:   register address, e.g. HCT6911_CONV_CONF0
 *   nbytes: register size, HCT6911_REG_24BIT or HCT6911_REG_32BIT
 *   value:  the new register value
 * Returns 0 on success, or a negative SPI error code.
 *
 * On the wire ([HCT] p.23, Fig 4-1/4-2), CS low for the whole frame:
 *   MOSI: [write command] [data, biggest byte first]
 */
int hct6911_write_reg(uint8_t addr, int nbytes, uint32_t value)
{
	uint8_t tx[1 + HCT6911_REG_32BIT] = { hct6911_cmd(addr, false) };

	if (nbytes == HCT6911_REG_32BIT) {
		sys_put_be32(value, &tx[1]);
	} else {
		sys_put_be24(value, &tx[1]);
	}

	const struct spi_buf tx_buf = { .buf = tx, .len = 1 + nbytes };
	const struct spi_buf_set tx_set = { .buffers = &tx_buf, .count = 1 };

	return spi_write_dt(&hct, &tx_set);
}

/* One-time set-up: check the SPI bus and the DRDY pin, and configure the DRDY pin as an input.
 * gpio_pin_configure_dt() is what makes GPIO_ACTIVE_LOW take effect for gpio_pin_get_dt().
 */
int hct6911_init(void)
{
	if (!spi_is_ready_dt(&hct)) {
		printf("HCT6911 init FAILED: SPI bus not ready\n");
		return -ENODEV;
	}
	if (!gpio_is_ready_dt(&drdy)) {
		printf("HCT6911 init FAILED: DRDY GPIO port not ready\n");
		return -ENODEV;
	}
	int err = gpio_pin_configure_dt(&drdy, GPIO_INPUT);

	if (err) {
		printf("HCT6911 init FAILED: DRDY pin configure error %d\n", err);
	}
	return err;
}

#define HCT6911_RESET_WAIT_MS  15	/* reset takes 10 ms ([HCT] p.40) + margin */

/* Step 4.1: global reset. Write 1 to SYS_CONF0 bit 31 RS_SYS; it clears itself after 10 ms
 * ([HCT] p.40, Table 5-6; procedure step 1 on p.60).
 * On failure: prints why and returns a negative error code.
 */
int hct6911_reset(void)
{
	uint32_t sys_conf0;

	int err = hct6911_write_reg(HCT6911_SYS_CONF0, HCT6911_REG_32BIT, HCT6911_SYS_CONF0_RS_SYS);

	if (err) {
		printf("HCT6911 reset FAILED: SPI error %d\n", err);
		return err;
	}
	k_msleep(HCT6911_RESET_WAIT_MS);

	err = hct6911_read_reg(HCT6911_SYS_CONF0, HCT6911_REG_32BIT, &sys_conf0);
	if (err) {
		printf("HCT6911 reset FAILED: SPI error %d\n", err);
		return err;
	}

	bool reset_still_running = (sys_conf0 & HCT6911_SYS_CONF0_RS_SYS) != 0;
	bool reset_succeeded     = (sys_conf0 & HCT6911_SYS_CONF0_RS_V) != 0;

	if (reset_still_running || !reset_succeeded) {
		printf("HCT6911 reset FAILED: SYS_CONF0 = 0x%08X (expected 0x00008000)\n", sys_conf0);
		return -EIO;
	}
	return 0;
}

/* Write a 32-bit register, read it back and compare.
 * On failure: prints what went wrong and returns a negative error code.
 */
static int write_reg32_and_verify(uint8_t addr, uint32_t value)
{
	uint32_t readback;

	int err = hct6911_write_reg(addr, HCT6911_REG_32BIT, value);

	if (err) {
		printf("HCT6911 write register 0x%02X FAILED: SPI error %d\n", addr, err);
		return err;
	}
	err = hct6911_read_reg(addr, HCT6911_REG_32BIT, &readback);
	if (err) {
		printf("HCT6911 read register 0x%02X FAILED: SPI error %d\n", addr, err);
		return err;
	}
	if (readback != value) {
		printf("HCT6911 register 0x%02X FAILED: read back 0x%08X, wrote 0x%08X\n",
		       addr, readback, value);
		return -EIO;
	}
	return 0;
}

/*
 * Step 4.2: configure for the DL002's 4-wire PT100 ([HCT] p.60, procedure steps 2-3), using
 * this board's HCT6911 pin names ([HCT] p.14-15, Table 2-1):
 *   IDAC0 1 mA out of AIN0 (pin 6) -> RTD_B2 -> PT100 -> RTD_A1 -> R74 1.62k -> GND
 *   measure AIN5 (pin 10, RTD_B1) minus AIN6 (pin 11, RTD_A2)
 *   reference REFP1/REFN1 (pins 9/8) = voltage across R74
 * On failure: prints why and returns a negative error code.
 */
int hct6911_setup_pt100(void)
{
	/* CONV_CONF0 fields: [HCT] p.36-39, Table 5-5 */
	uint32_t conv_conf0 =
		BIT(31) |		/* CONV_EN: use this conversion setting */
		(0x8 << 20) |		/* DR: 25 Hz data rate */
		(0x1 << 16) |		/* FLIT_TYPE: 3rd-order filter */
		(0x0 << 14) |		/* REFSEL: REFP1/REFN1 = across R74 */
					/* bits 13/12 = 0: signal + reference buffers ON (default) */
		(0x3 << 8) |		/* GA: gain x8 (schematic) */
		(0x6 << 4) |		/* VNSEL: negative input = AIN6 (pin 11) */
		(0x5 << 0);		/* VPSEL: positive input = AIN5 (pin 10) */

	/* SYS_CONF2 fields: [HCT] p.45-46, Table 5-8 */
	uint32_t sys_conf2 =
		(0x0 << 8) |		/* IDAC0_CH: current out of AIN0 (pin 6) */
		(0x5 << 0);		/* IDAC0: 1000 uA (schematic) */

	int err = write_reg32_and_verify(HCT6911_CONV_CONF0, conv_conf0);

	if (err) {
		return err;
	}

	err = write_reg32_and_verify(HCT6911_SYS_CONF2, sys_conf2);
	
	return err;
}

/*
 * DOUT/DRDY# (pin 15) is read on PC03 (= MISO) while the chip converts ([HCT] p.26):
 *   busy  = chip has released the pin, R82 1 MΩ pulls it HIGH
 *   ready = chip pulls it LOW, result can be clocked out
 * drdy is GPIO_ACTIVE_LOW in the DTS, so gpio_pin_get_dt() returns 1 when ready.
 */
static bool drdy_is_ready(void)
{
	return gpio_pin_get_dt(&drdy) == 1;
}

#define HCT6911_CONV_TIMEOUT_MS  500	/* one result takes ~120 ms ([HCT] p.19), so ~4x margin */

/* Poll DRDY every 1 ms until the result is ready. Returns the ms waited, or -ETIMEDOUT. */
static int wait_until_ready(int timeout_ms)
{
	for (int waited_ms = 0; waited_ms <= timeout_ms; waited_ms++) {
		if (drdy_is_ready()) {
			return waited_ms;
		}
		k_msleep(1);
	}
	return -ETIMEDOUT;
}

/*
 * Step 4.3: one single conversion ([HCT] p.25-26, Table 4-4/4-5, Fig 4-7).
 * CS is held LOW from the start command until the result has been read.
 *   1. before start: DOUT is HIGH (idle, R82 pull-up)
 *   2. send CMD_SINGLE_CONVERSION (0x80) = "start measuring"
 *   3. wait for DOUT LOW = result ready (~120 ms at 25 Hz, 3rd-order filter, [HCT] p.19)
 *   4. send CMD_READ_RESULT (0x42) = "send me the result", clock in 24 bits, CS HIGH
 *   5. SYS_CONF0 CKS_ERR = 0: no command byte was rejected ([HCT] p.41)
 * On failure: prints which step failed and returns a negative error code.
 */
int hct6911_read_raw(int32_t *code)
{
	uint8_t cmd = HCT6911_CMD_SINGLE_CONVERSION;
	const struct spi_buf cmd_buf = { .buf = &cmd, .len = 1 };
	const struct spi_buf_set cmd_set = { .buffers = &cmd_buf, .count = 1 };

	uint8_t tx[1 + HCT6911_RESULT_BYTES] = { HCT6911_CMD_READ_RESULT };	/* rest is 0x00 while we listen */
	uint8_t rx[1 + HCT6911_RESULT_BYTES];
	const struct spi_buf tx_buf = { .buf = tx, .len = sizeof(tx) };
	const struct spi_buf rx_buf = { .buf = rx, .len = sizeof(rx) };
	const struct spi_buf_set tx_set = { .buffers = &tx_buf, .count = 1 };
	const struct spi_buf_set rx_set = { .buffers = &rx_buf, .count = 1 };

	/* 1. Idle line must be HIGH before we start */
	if (drdy_is_ready()) {
		printf("HCT6911 step 1 FAILED: DOUT is LOW before start (expected HIGH)\n");
		return -EIO;
	}

	/* 2. Send the single-conversion command; CS stays LOW (hct_conv has SPI_HOLD_ON_CS) */
	int err = spi_write_dt(&hct_conv, &cmd_set);

	if (err) {
		spi_release_dt(&hct_conv);
		printf("HCT6911 step 2 FAILED: SPI error %d sending the conversion command\n", err);
		return err;
	}

	/* 3. Wait for DOUT LOW = result ready */
	int ready_ms = wait_until_ready(HCT6911_CONV_TIMEOUT_MS);

	if (ready_ms < 0) {
		spi_release_dt(&hct_conv);
		printf("HCT6911 step 3 FAILED: no result within %d ms\n", HCT6911_CONV_TIMEOUT_MS);
		return -ETIMEDOUT;
	}

	/* 4. Send CMD_READ_RESULT and read the 24-bit result, then CS HIGH to end the frame */
	err = spi_transceive_dt(&hct_conv, &tx_set, &rx_set);
	spi_release_dt(&hct_conv);
	if (err) {
		printf("HCT6911 step 4 FAILED: SPI error %d reading data\n", err);
		return err;
	}

	/* 5. Did the chip reject any command byte? (reading SYS_CONF0 also clears the flag) */
	uint32_t sys_conf0;

	err = hct6911_read_reg(HCT6911_SYS_CONF0, HCT6911_REG_32BIT, &sys_conf0);
	if (err) {
		printf("HCT6911 step 5 FAILED: SPI error %d reading SYS_CONF0\n", err);
		return err;
	}
	if (sys_conf0 & HCT6911_SYS_CONF0_CKS_ERR) {
		printf("HCT6911 step 5 FAILED: CKS_ERR set, SYS_CONF0 = 0x%08X\n", sys_conf0);
		return -EIO;
	}

	/* rx[0] arrived during the CMD_READ_RESULT byte: skip it.
	 * Result is 24-bit signed, biggest byte first; bit 23 is the sign bit ([HCT] p.49).
	 */
	*code = sign_extend(sys_get_be24(&rx[1]), 23);
	return 0;
}
```

## src/hct6911.h
```c
#ifndef HCT6911_H
#define HCT6911_H

#include <stdint.h>
#include <zephyr/sys/util.h>	/* BIT() */

/* Register addresses ([HCT] p.33-34, Table 5-1) */
#define HCT6911_OS_CH0     0x00	/* 24 bit, R/W, default 0x000000 */
#define HCT6911_GAIN_CH0   0x01	/* 24 bit, R/W, default 0x400000 */
#define HCT6911_D_TARG     0x10	/* 24 bit, R/W, default 0x7FFFFF */
#define HCT6911_CONV_CONF0 0x11	/* 32 bit, R/W, default 0x00000000 */
#define HCT6911_SYS_CONF0  0x1B	/* 32 bit, R/W, default 0x00008000 */
#define HCT6911_SYS_CONF2  0x1D	/* 32 bit, R/W, default 0x00000000 */

/* Register sizes in bytes ([HCT] p.33-34, Table 5-1) */
#define HCT6911_REG_24BIT  3
#define HCT6911_REG_32BIT  4

/* Conversion frame ([HCT] p.25-26, Table 4-4, Fig 4-7) */
#define HCT6911_CMD_SINGLE_CONVERSION  0x80	/* bit 7 = 1 conversion frame, CONV_MOD 0 = single, parity 0 */
#define HCT6911_CMD_READ_RESULT        0x42	/* must be sent in the 8 clocks before the result */
#define HCT6911_RESULT_BYTES           3	/* result is 24-bit signed ([HCT] p.49) */

/* SYS_CONF0 bits ([HCT] p.40-42, Table 5-6) */
#define HCT6911_SYS_CONF0_RS_SYS   BIT(31)	/* write 1 = start reset; reads 1 while resetting */
#define HCT6911_SYS_CONF0_RS_V     BIT(15)	/* 1 = last reset succeeded */
#define HCT6911_SYS_CONF0_CKS_ERR  BIT(10)	/* 1 = a command byte was rejected (parity/CRC) */

int hct6911_read_reg(uint8_t addr, int nbytes, uint32_t *value);
int hct6911_write_reg(uint8_t addr, int nbytes, uint32_t value);

int hct6911_init(void);
int hct6911_reset(void);
int hct6911_setup_pt100(void);
int hct6911_read_raw(int32_t *code);

#endif
```

## src/pt100.c
```c
/*
 * PT100 maths for the DL002 front end.
 * [SCH] PT100 box: 4-wire, IDAC 1 mA, gain 8, reference R74 = 1.62 kΩ 0.1 %,
 *       range -100 ... +220 °C, error 0.5 °C
 * [CVD] IEC 60751 Callendar–Van Dusen equation (also TI SBAA275, "A Basic Guide to RTD Measurements")
 */

#include <math.h>	/* sqrtf() */
#include "pt100.h"

/* code -> resistance ([SCH] formula, [HCT] p.49 + p.53): R = code / 2^23 / gain * Rref */
#define PT100_RREF_OHM        1620.0f		/* R74 */
#define PT100_ADC_GAIN        8.0f		/* must match GA in hct6911_setup_pt100() */
#define PT100_ADC_FULL_SCALE  8388608.0f	/* 2^23: the result is 24-bit signed */

float pt100_code_to_ohm(int32_t code)
{
	return (float)code / PT100_ADC_FULL_SCALE / PT100_ADC_GAIN * PT100_RREF_OHM;
}

/*
 * [CVD], R0 = 100 Ω:
 *   R(T) / R0 = 1 + A*T + B*T^2                        at or above 0 °C
 *   R(T) / R0 = 1 + A*T + B*T^2 + C*(T - 100)*T^3      below 0 °C
 */
#define PT100_R0_OHM  100.0f
#define CVD_A         3.9083e-3f
#define CVD_B         (-5.775e-7f)
#define CVD_C         (-4.183e-12f)

/*
 * 1. Quadratic formula: exact at or above 0 °C (no C term there).
 * 2. Below 0 °C it ignores C (up to 0.2 °C off at -100 °C), so correct it once with
 *    Newton's method: work out R/R0 at that temperature, see how far it is from what
 *    we measured, and move the temperature by error / slope.
 * Checked on PC (float maths, -100 ... +220 °C): error < 0.001 °C.
 */
float pt100_ohm_to_celsius(float r_ohm)
{
	float measured_ratio = r_ohm / PT100_R0_OHM;	/* R / R0 */

	/* 1. solve 1 + A*T + B*T^2 = R/R0 for T */
	float temp_c = (-CVD_A + sqrtf(CVD_A * CVD_A - 4.0f * CVD_B * (1.0f - measured_ratio))) /
		       (2.0f * CVD_B);

	if (temp_c >= 0.0f) {
		return temp_c;
	}

	/* 2. below 0 °C: one Newton correction including the C term */
	float temp_c_squared = temp_c * temp_c;

	/* R/R0 the full formula gives at temp_c, minus what we measured */
	float ratio_error = 1.0f + CVD_A * temp_c + CVD_B * temp_c_squared +
			    CVD_C * (temp_c - 100.0f) * temp_c_squared * temp_c - measured_ratio;
	/* how fast R/R0 changes per °C at temp_c */
	float ratio_slope = CVD_A + 2.0f * CVD_B * temp_c +
			    CVD_C * (4.0f * temp_c_squared * temp_c - 300.0f * temp_c_squared);

	return temp_c - ratio_error / ratio_slope;
}
```

## src/pt100.h
```c
#ifndef PT100_H
#define PT100_H

#include <stdint.h>

/* Rated probe range ([SCH]: -100 ... +220 °C). A reading outside it is not trusted:
 * most likely the probe is unplugged, broken or shorted.
 */
#define PT100_MIN_CELSIUS  (-100.0f)
#define PT100_MAX_CELSIUS  (220.0f)

float pt100_code_to_ohm(int32_t code);
float pt100_ohm_to_celsius(float r_ohm);

#endif
```
