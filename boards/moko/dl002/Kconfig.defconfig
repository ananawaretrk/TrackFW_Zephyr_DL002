## boards/moko/dl002/board.yml
```yaml
board:
  name: dl002
  full_name: MOKO DL002
  vendor: moko
  socs:
  - name: efr32bg22c224f512gm32
```

## boards/moko/dl002/dl002_defconfig
```kconfig
CONFIG_ARM_MPU=y
CONFIG_HW_STACK_PROTECTION=y
CONFIG_GPIO=y
CONFIG_FLASH=y
CONFIG_REGULATOR=y
```

## boards/moko/dl002/dts/bindings/hctmicro,hct6911.yaml
```yaml
description: HCT Micro HCT6911 24-bit sigma-delta ADC (SPI)

compatible: "hctmicro,hct6911"

include: spi-device.yaml

properties:
  drdy-gpios:
    type: phandle-array
    required: true
    description: |
      DOUT/DRDY# pin (same pin as MISO). Goes low when a conversion
      result is ready to be read.
```
